## sources/conf/bblayers.conf
```bitbake
# POKY_BBLAYERS_CONF_VERSION is increased each time build/conf/bblayers.conf
# changes incompatibly
POKY_BBLAYERS_CONF_VERSION = "2"

BBPATH = "${TOPDIR}"
BBFILES ?= ""

BBLAYERS ?= " \
  /home/alfaquillo/tools/poky/meta \
  /home/alfaquillo/tools/poky/meta-poky \
  /home/alfaquillo/tools/poky/meta-yocto-bsp \
  /home/alfaquillo/tools/meta-openembedded/meta-oe \
  /home/alfaquillo/tools/meta-openembedded/meta-networking \
  /home/alfaquillo/tools/meta-openembedded/meta-python \
  /home/alfaquillo/tools/meta-tensorflow \
  /home/alfaquillo/tools/poky/meta-rpi-navigator \
  /home/alfaquillo/tools/meta-raspberrypi \
  /home/alfaquillo/tools/meta-qt5 \
 "
```

## sources/yocto/meta-rpi-navigator/conf/layer.conf
```bitbake
BBPATH .= ":${LAYERDIR}"

BBFILES += "${LAYERDIR}/recipes-*/*/*.bb \
            ${LAYERDIR}/recipes-*/*/*.bbappend"

BBFILE_COLLECTIONS += "meta-rpi-navigator"
BBFILE_PATTERN_meta-rpi-navigator = "^${LAYERDIR}/"
BBFILE_PRIORITY_meta-rpi-navigator = "6"

LAYERSERIES_COMPAT_meta-rpi-navigator = "kirkstone"
```
